## config/boards/shields/two_percent_milk_sg/Kconfig.defconfig
```kconfig
if SHIELD_TWO_PERCENT_MILK_SG

config ZMK_KEYBOARD_NAME
    default "two_percent_milk_SG"

config BT_DEVICE_NAME
    default "milk_SG1"

endif
```

## config/boards/shields/two_percent_milk_sg/Kconfig.shield
```kconfig
config SHIELD_TWO_PERCENT_MILK_SG
    def_bool $(shields_list_contains, two_percent_milk_SG)
```
