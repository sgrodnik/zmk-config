/ {
    chosen {
        zmk,kscan = &default_kcsan;
    };

    default_kcsan: kscan {
        compatible = "zmk,kscan-gpio-direct";
        label = "default_kscan";

        input-gpios =
            <&pro_micro 1 (GPIO_ACTIVE_HIGH | GPIO_PULL_DOWN)>,
            <&pro_micro 2 (GPIO_ACTIVE_HIGH | GPIO_PULL_DOWN)>,
            <&pro_micro 3 (GPIO_ACTIVE_HIGH | GPIO_PULL_DOWN)>
    };
};